#include <ESP8266WiFi.h>
#include <WiFiClient.h>
#include <ESP8266WebServer.h>
#include <ESP8266mDNS.h>
#include <math.h>
#include <SoftwareSerial.h>

#define IR_T 5 
#define IR_R 4 

SoftwareSerial mySerial(IR_R, IR_T); // RX, TX

ESP8266WebServer server(80);

const char* ssid = "";
const char* password = "";
String LastStatus = "Last action: NA";

void sendIrOn();
void sendIrOff();
 
void handleRoot() {
  String message = "<html><head><title>IR Controller</title></head><body style='background-color:#838383'>";
  message += "<meta name=\"viewport\" content=\"width=device-width, initial-scale=1.0, user-scalable=yes\">";
  message += "<center><br><h1>IR Controller</h1><br>";
  message += "<a href=\"send?cmd=sendcmd1\"><button style='width:40%;max-width:200px'>Send IR On</button></a><br><br><br>";
  message += "<a href=\"send?cmd=sendcmd2\"><button style='width:40%;max-width:200px'>Send IR Off</button></a><br><br><br>";
  message += "<h3>" + LastStatus + "</h3><br>";   
  message += "</center></body></html>";             
  server.send(200, "text/html", message); 
  LastStatus = "Last action: NA"; // output result to website
}

void handleSend() {
  Serial.print("Send Request: ");
  String message = "";  
  
  if (server.arg("cmd") == "sendcmd1") {
    Serial.println("Command sendcmd1!"); 
    Serial.flush();    
    sendIrOn();
  } else if (server.arg("cmd") == "sendcmd2") {
    Serial.println("Command sendcmd2!");
    Serial.flush(); 
    sendIrOff();    
  } else {
    Serial.println("Command unknown!");
    LastStatus = "Command unknown!";           
  }
  handleRoot();  
}

void handleNotFound(){
  Serial.print("No handle for this URL found: "); 
  Serial.println(server.uri());  
  String message = "File Not Found\n\n";
  message += "URI: ";
  message += server.uri();
  message += "\nMethod: ";
  message += (server.method() == HTTP_GET)?"GET":"POST";
  message += "\nArguments: ";
  message += server.args();
  message += "\n";
  for (uint8_t i=0; i<server.args(); i++){
    message += " " + server.argName(i) + ": " + server.arg(i) + "\n";
  }
  server.send(404, "text/plain", message);
}
 

void sendIrOn() {
  Serial.println("Sending On..");

  // Array in hex. {227, followed by your ir code}
  uint8_t irArray[] = {0xE3, 0x98, 0x23, 0xB5, 0x8C, 0xF7, 0x80, 0x5F, 0xB9, 0x49, 0x5E, 0x5E, 0xF0,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 0x25, 0x81};
 
  // Write the array to Serial port.
  mySerial.write((uint8_t*)irArray, sizeof(irArray));

  // Read the response.
  int len = 0;
  int r;
  unsigned long timeout = 700;
  unsigned long start = millis();
  int buffer[1];
  memset(buffer, 0, sizeof(buffer));
       
  while (millis() - start < timeout) {
    if (mySerial.available()) {
      buffer[0] = mySerial.read();
    }

   delay(1);
  }

  if(buffer[0] == 255) { // ff
    Serial.println("Error starting..");
  }
  else {
    Serial.println("Success!..");
  }
}

void sendIrOff() {
  Serial.println("Sending Off..");

  // Array in hex. {227, xxx}
  uint8_t irArray[] = {0xE3, 0x98, 0x23, 0xB5, 0x8C, 0xF7, 0x80, 0x5F, 0xB9, 0x49, 0x5E, 0x5E, 0xF0,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 0x25, 0x81};
 
  // Write the array to Serial port.
  mySerial.write((uint8_t*)irArray, sizeof(irArray));

  // Read the response.
  int len = 0;
  int r;
  unsigned long timeout = 700;
  unsigned long start = millis();
  int buffer[1];
  memset(buffer, 0, sizeof(buffer));
       
  while (millis() - start < timeout) {
    if (mySerial.available()) {
      buffer[0] = mySerial.read();
    }

   delay(1);
  }

  if(buffer[0] == 255) { // ff
    Serial.println("Error starting..");
  }
  else {
    Serial.println("Success!..");
  }
}
 

void setup(void){
  Serial.begin(9600);
  delay(200);  
  WiFi.begin(ssid, password);
  Serial.println();
  Serial.print("Connecting to Wifi: ");
  Serial.println(ssid);  
  Serial.print("Connecting");
  
  while (WiFi.status() != WL_CONNECTED)
  {
    delay(500);
    Serial.print(".");
  }

  mySerial.begin(9600); // Start communicating with IR controller

  server.on("/", handleRoot);
  server.on("/send", handleSend);
  server.onNotFound(handleNotFound);
  server.begin();
  
  Serial.println();
  Serial.print("Open your browser and visit: ");
  Serial.println(WiFi.localIP());
}

void loop(void){
  server.handleClient();
}
